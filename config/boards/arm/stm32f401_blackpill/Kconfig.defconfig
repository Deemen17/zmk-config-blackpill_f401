## config/boards/arm/stm32f401_blackpill/Kconfig.defconfig
```kconfig
# STM32F401 BlackPill board configuration

# Copyright (c) 2021 Pete Johanson
# SPDX-License-Identifier: Apache-2.0

if BOARD_STM32F401_BLACKPILL

config ZMK_KEYBOARD_NAME
	default "stm32f401_blackpill"

config ZMK_USB
	default y

config ZMK_BATTERY_VOLTAGE_DIVIDER
	default n

endif # BOARD_STM32F401_BLACKPILL
```

## config/west.yml
```yaml
manifest:
  remotes:
    - name: zmkfirmware
      url-base: https://github.com/zmkfirmware
    - name: Deemen17
      url-base: https://github.com/Deemen17
  projects:
    - name: zmk
      remote: zmkfirmware
      revision: main
      import: app/west.yml
  self:
    path: config
```
